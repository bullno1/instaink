## sdkconfig.defaults
```kconfig
CONFIG_ESPTOOLPY_FLASHSIZE_16MB=y
CONFIG_PARTITION_TABLE_CUSTOM=y
CONFIG_SPIRAM=y
CONFIG_SPIRAM_MODE_OCT=y
CONFIG_ESP_MAIN_TASK_STACK_SIZE=6000
CONFIG_ESP_WIFI_STATIC_TX_BUFFER=y
CONFIG_SPIRAM_SPEED_80M=y
CONFIG_SPIRAM_USE_MALLOC=y
CONFIG_ESP_CONSOLE_USB_CDC=y
CONFIG_TINYUSB_CDC_ENABLED=y
CONFIG_ESP32S3_DATA_CACHE_LINE_32B=n
CONFIG_ESP32S3_DATA_CACHE_LINE_64B=y
CONFIG_ESP32S3_DATA_CACHE_LINE_SIZE=64
```
